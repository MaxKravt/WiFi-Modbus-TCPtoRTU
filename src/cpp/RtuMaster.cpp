#include "..\h\RtuMaster.h"
#include "..\h\trace.h"
extern cTcpTrace trace;

RtuMaster::RtuMaster()
{
  Serial.begin(115200);
}

RtuMaster::~RtuMaster()
{
}

uint16_t RtuMaster::calculateCRC(uint8_t * buff, uint16_t len)
{
  uint16_t temp, temp2, flag;
  temp = 0xFFFF;
  for (uint16_t i = 0; i < len; i++)
  {
    temp = temp ^ *(buff +i);
    for (uint8_t j = 1; j <= 8; j++)
    {
      flag = temp & 0x0001;
      temp >>= 1;
      if (flag)
        temp ^= 0xA001;
    }
  }
  return temp;
}


void RtuMaster::task()
{
  static uint16_t status = 0; //

  switch(status)
  {
    case 0: // Отправка пакета
    {
      cTcpSlave::smbFrame * pmbFrame = TcpSlave.getReadyToSendRtuBuffer();
      if(pmbFrame)
      {
      //  trace.print ("Send pack. CRC  ");
        uint16_t crcFrame = CRC16(pmbFrame->buffer + 6, (pmbFrame->len) - 6 );
        //trace.print (crcFrame);
        *((pmbFrame->buffer) + (pmbFrame->len) +1)    = (uint8_t) (crcFrame >> 8);
        *((pmbFrame->buffer) + (pmbFrame->len) +0) = (uint8_t)  (crcFrame & 0xFF);
        size_t len = (pmbFrame->len) + 2;
        size_t count = 6;
        while (count < len)
          Serial.write((uint8_t)*(pmbFrame->buffer + (count++)));
        pmbFrame->status = cTcpSlave::frameStatus::waitFromRtu;
      //  trace.println (String(" Status: ") + String(status) +
      //   String("Len: ") + String((pmbFrame->len)-4) );
        pmbFrame->millis   = millis();
        status = 1;

      }
      break;
    }
    case 1: // Ожидане ответа
    {
      cTcpSlave::smbFrame * pmbFrame = TcpSlave.getWaitFromRtuBuffer();
      if (pmbFrame)
      {
        if (Serial.available())
          {
            pmbFrame->millis   = millis();
            pmbFrame->len = 6;
            status = 2;
          }
      }
      else
        status = 0;
      break;
    }
    case 2: // чтение ответа
    {
      cTcpSlave::smbFrame * pmbFrame = TcpSlave.getWaitFromRtuBuffer();
      if (pmbFrame)
      {
        if (Serial.available())
          {
            pmbFrame->millis = millis();
            while(Serial.available())
            {
              if (pmbFrame->len <= RTU_BUFFER_SIZE)
              {
              *(pmbFrame->buffer + pmbFrame->len) =  Serial.read();
                pmbFrame->len ++;
              }
            }
          }
        else
          if (millis() - pmbFrame->millis > 2)
          {
              uint16_t crcFrame = CRC16(pmbFrame->buffer + 6, (pmbFrame->len) - 6 );
              if (!crcFrame)
              {
                pmbFrame->len -= 2;
                *(pmbFrame->buffer + 5) = (uint8_t) pmbFrame->len-6;
                pmbFrame->status = cTcpSlave::frameStatus::readyToSendTcp;
              }
              else
              {
                status = 0;
                pmbFrame->status = cTcpSlave::frameStatus::empty;
                while(Serial.available()) Serial.read();
              }
          }
      }
      else
        status = 0;
      break;
    }
  }
}

//Расчет CRC16
uint16_t RtuMaster::CRC16(uint8_t *puchMsg, uint16_t usDataLen)
{
const uint8_t auchCRCHi[] = {
		0x00, 0xC1, 0x81, 0x40, 0x01, 0xC0, 0x80, 0x41, 0x01, 0xC0, 0x80, 0x41, 0x00, 0xC1, 0x81,
		0x40, 0x01, 0xC0, 0x80, 0x41, 0x00, 0xC1, 0x81, 0x40, 0x00, 0xC1, 0x81, 0x40, 0x01, 0xC0,
		0x80, 0x41, 0x01, 0xC0, 0x80, 0x41, 0x00, 0xC1, 0x81, 0x40, 0x00, 0xC1, 0x81, 0x40, 0x01,
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		0x00, 0xC1, 0x81, 0x40, 0x01, 0xC0, 0x80, 0x41, 0x01, 0xC0, 0x80, 0x41, 0x00, 0xC1, 0x81,
		0x40
	} ;
const uint8_t auchCRCLo[] = {
		0x00, 0xC0, 0xC1, 0x01, 0xC3, 0x03, 0x02, 0xC2, 0xC6, 0x06, 0x07, 0xC7, 0x05, 0xC5, 0xC4,
		0x04, 0xCC, 0x0C, 0x0D, 0xCD, 0x0F, 0xCF, 0xCE, 0x0E, 0x0A, 0xCA, 0xCB, 0x0B, 0xC9, 0x09,
		0x08, 0xC8, 0xD8, 0x18, 0x19, 0xD9, 0x1B, 0xDB, 0xDA, 0x1A, 0x1E, 0xDE, 0xDF, 0x1F, 0xDD,
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		0x44, 0x84, 0x85, 0x45, 0x87, 0x47, 0x46, 0x86, 0x82, 0x42, 0x43, 0x83, 0x41, 0x81, 0x80,
		0x40	};



		uint8_t uIndex;
		uint8_t uchCRCHi = 0xFF;
		uint8_t uchCRCLo = 0xFF;

		while (usDataLen--)
		{
			uIndex = uchCRCLo ^ *puchMsg++;
 			uchCRCLo = uchCRCHi  ^ auchCRCHi[uIndex];
			uchCRCHi = auchCRCLo[uIndex] ;
 		}
		return ((uchCRCHi * 0x100 )| uchCRCLo);
	}


RtuMaster _RtuMaster;

//void RtuMaster::sendPacket(unsigned char bufferSize)
//{
//  for (unsigned char i = 0; i < bufferSize; i++) {
//    Serial.write(_frame[i]);
//  }
//  Serial.flush();
//  // allow a _frame delay to indicate end of transmission
//  delayMicroseconds(T3_5);
//}

// get the serial data from the buffer
//Status::RtuError RtuMaster::getData()
//{
//  unsigned int index = 0;
//  unsigned char overflowFlag = 0;

//  while (Serial.available())
//  {
    // The maximum number of bytes is limited to the serial buffer size of 128 bytes
    // If more bytes is received than the BUFFER_SIZE the overflow flag will be set and the
    // serial buffer will be red untill all the data is cleared from the receive buffer,
    // while the slave is still responding.
//    if (overflowFlag)
//      Serial.read();
//    else
//    {
//      if (index == RTU_BUFFER_SIZE) {
//        overflowFlag = 1;
//      }
//      _frame[index] = Serial.read();
//      index++;
//    }

//    delayMicroseconds(T1_5); // inter character time out
//  }

  // The minimum buffer size from a slave can be an exception response of 5 bytes
  // If the buffer was partialy filled clear the buffer.
  // The maximum number of bytes in a modbus packet is 256 bytes.
  // The serial buffer limits this to 128 bytes.
  // If the buffer overflows than clear the buffer and set
  // a packet error.
//  if ((index > 0 && index < 5) || overflowFlag)
//  {
//    index = 0;
//    trace.println ("Read from serial port Error");
//    return Status::buffer_errors;
//  }
//  trace.println ("Read from serial port OK");
//  return index == 0 ? Status::nothing : Status::ok;
//}
